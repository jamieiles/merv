// SPDX-License-Identifier: GPL-2.0+
// merv on the Arty S7-50, see fpga/xilinx/MervArtyBD.tcl for the memory map.
// Preprocessed with cpp, NUM_HARTS must match the bitstream's MERV_NUM_HARTS
// and RNG_SEED, if defined, is the comma free list of bytes for rng-seed.
/dts-v1/;

#include "merv-cpus.dtsi"

/ {
    #address-cells = <1>;
    #size-cells = <1>;
    compatible = "jamieiles,merv-arty";
    model = "merv Arty S7-50";

    aliases {
        serial0 = &uart0;
    };

    chosen {
        // The core is slow enough that systemd's default unit start timeouts
        // expire (udevd coldplug in particular).
        bootargs = "console=ttyS0,115200 earlycon root=/dev/mmcblk0p2 ro systemd.default_timeout_start_sec=900";
        stdout-path = "serial0:115200n8";
#ifdef RNG_SEED
        // Seeds the CRNG at boot rather than waiting for interrupt entropy,
        // which takes a long time on the slow core.
        rng-seed = /bits/ 8 <RNG_SEED>;
#endif
    };

    cpus {
        #address-cells = <1>;
        #size-cells = <0>;
        timebase-frequency = <10140625>;

        MERV_CPUS
    };

    memory@80000000 {
        device_type = "memory";
        reg = <0x80000000 0x10000000>;
    };

    sdclk: clock-81247969 {
        compatible = "fixed-clock";
        #clock-cells = <0>;
        clock-frequency = <81247969>;
    };

    soc {
        #address-cells = <1>;
        #size-cells = <1>;
        compatible = "simple-bus";
        ranges;

        clint0: clint@f0000000 {
            compatible = "sifive,clint0", "riscv,clint0";
            interrupts-extended = MERV_CLINT_IRQS;
            reg = <0xf0000000 0xc000>;
        };

        syscon: syscon@f000c000 {
            compatible = "syscon";
            reg = <0xf000c000 0x1000>;

            reboot {
                compatible = "syscon-reboot";
                regmap = <&syscon>;
                offset = <0x0>;
                mask = <0x1>;
                value = <0x1>;
            };
        };

        plic: interrupt-controller@f8000000 {
            compatible = "sifive,plic-1.0.0", "riscv,plic0";
            #address-cells = <0>;
            #interrupt-cells = <1>;
            interrupt-controller;
            reg = <0xf8000000 0x400000>;
            interrupts-extended = MERV_PLIC_IRQS;
            riscv,ndev = <4>;
        };

        mmc0: mmc@fffc0000 {
            compatible = "arasan,sdhci-8.9a";
            reg = <0xfffc0000 0x10000>;
            clocks = <&sdclk>, <&sdclk>;
            clock-names = "clk_xin", "clk_ahb";
            // No caches: SDMA is coherent with the CPU.
            interrupt-parent = <&plic>;
            interrupts = <4>;
            bus-width = <4>;
            cap-sd-highspeed;
            max-frequency = <40623984>;
            no-1-8-v;
            disable-wp;
            no-sdio;
            no-mmc;
            broken-cd;
        };

        spi0: spi@fffe0000 {
            compatible = "xlnx,xps-spi-2.00.a";
            reg = <0xfffe0000 0x10000>;
            xlnx,num-ss-bits = <0x1>;
            xlnx,num-transfer-bits = <8>;
            #address-cells = <1>;
            #size-cells = <0>;
            interrupt-parent = <&plic>;
            interrupts = <1>;

            // There is no network configuration, disabled so that the
            // networking services don't wait for it.
            eth0: eth@0 {
                compatible = "microchip,enc28j60";
                status = "disabled";
                reg = <0>;
                interrupt-parent = <&plic>;
                // Falling edge, latched until claimed by PLICAXI.
                interrupts = <3>;
                spi-max-frequency = <50000000>;
            };
        };

        uart0: serial@ffff1000 {
            compatible = "ns16550a";
            reg = <0xffff1000 0x1000>;
            clock-frequency = <81247969>;
            reg-shift = <2>;
            reg-io-width = <4>;
            interrupt-parent = <&plic>;
            interrupts = <2>;
            current-speed = <115200>;
        };
    };
};
